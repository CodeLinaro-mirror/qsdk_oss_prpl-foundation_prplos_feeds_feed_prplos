## gmap/apps/gmap-client/Config.in
```kconfig
config PACKAGE_gmap-client
    tristate
    select SAH_AMX_GMAP_CLIENT

if PACKAGE_gmap-client

menu "Select gmap-client build options"
    depends on PACKAGE_gmap-client

config SAH_AMX_GMAP_CLIENT
    bool "Build the gMap client plugin"
    default y

config SAH_AMX_GMAP_CLIENT_ORDER
    int "gMap client plugin startup order"
    default 82

config SAH_AMX_GMAP_CLIENT_ONE_PROCESS
    bool "All gMap client modules run in same process"
    default n

config SAH_AMX_GMAP_CLIENT_RUN_AS_USER
    string "User will be used for the gmap-client plugin"
    default "tr181_app"

config SAH_AMX_GMAP_CLIENT_RUN_AS_GROUP
    string "Group will be used for the gmap-client plugin"
    default "tr181_app"

endmenu

endif
```

## gmap/apps/gmap-server/Config.in
```kconfig
config PACKAGE_gmap-server
    tristate
    select SAH_AMX_GMAP_SERVER

if PACKAGE_gmap-server

menu "Select gmap-server build options"
    depends on PACKAGE_gmap-server

config SAH_AMX_GMAP_SERVER
    bool "Build gMap server"
    default y

config SAH_AMX_GMAP_SERVER_RUN_AS_USER
    string "User that will be used for the gmap-server plugin"
    default "tr181_app"

config SAH_AMX_GMAP_SERVER_RUN_AS_GROUP
    string "Group that will be used for the gmap-server plugin"
    default "tr181_app"

config SAH_AMX_GMAP_SERVER_START_ORDER
    int "gMap server plugin startup order"
    default 71

config SAH_AMX_GMAP_SERVER_STOP_ORDER
    int "gMap server plugin shutdown order"
    default 29

endmenu

endif
```

## net_core/plugins/tr181-ppp/Config.in
```kconfig
config PACKAGE_tr181-ppp
    tristate
    select SAH_AMX_TR181_PPP

if PACKAGE_tr181-ppp

menu "Select tr181-ppp build options"
    depends on PACKAGE_tr181-ppp

config SAH_AMX_TR181_PPP
    bool "Build TR-181 compatible PPP plugin"
    default y

config SAH_AMX_TR181_PPP_START_ORDER
    int "Init start up order for the TR-181 compatible PPP plugin"
    default 26

config SAH_AMX_TR181_PPP_STOP_ORDER
    int "Init stop order for the TR-181 compatible PPP plugin"
    default 74

config SAH_AMX_TR181_PPP_RUN_AS_USER
    string "User will be used for the tr181-ppp plugin"
    default "tr181_app"

config SAH_AMX_TR181_PPP_RUN_AS_GROUP
    string "Group will be used for the tr181-ppp plugin"
    default "tr181_app"

endmenu

endif
```

## net_core/plugins/tr181-sfp/Config.in
```kconfig
config PACKAGE_tr181-sfp
    tristate
    select SAH_AMX_TR181_SFP

if PACKAGE_tr181-sfp

menu "Select tr181-sfp build options"
    depends on PACKAGE_tr181-sfp

config SAH_AMX_TR181_SFP
    bool "Build a TR-181 compatible SFP plugin"
    default y

config SAH_AMX_TR181_SFP_ORDER
    int "SFP manager plugin start up order"
    default 30

config SAH_AMX_TR181_SFP_RUN_AS_USER
    string "User will be used for the tr181-sfp plugin"
    default "tr181_app"

config SAH_AMX_TR181_SFP_RUN_AS_GROUP
    string "Group will be used for the tr181-sfp plugin"
    default "tr181_app"

endmenu

endif
```

## net_core/plugins/tr181-usb/Config.in
```kconfig
config PACKAGE_tr181-usb
    tristate
    select AMX_TR181_USB

if PACKAGE_tr181-usb

menu "Select tr181-usb build options"
    depends on PACKAGE_tr181-usb

config AMX_TR181_USB
    bool "Build a TR-181 compatible USB manager"
    default y

config AMX_TR181_USB_ORDER
    int "Start up order for the tr181-usb manager"
    default 81

config AMX_TR181_USB_BUSYBOX_MDEV_OPTIONS
    bool "Enable busybox support for mdev device events"
    default n

config AMX_TR181_USB_RUN_AS_USER
    string "User will be used for the tr181-usb plugin"
    default "tr181_app"

config AMX_TR181_USB_RUN_AS_GROUP
    string "Group will be used for the tr181-usb plugin"
    default "tr181_app"

endmenu

endif
```

## net_core/plugins/tr181-xpon/Config.in
```kconfig
config PACKAGE_tr181-xpon
    tristate
    select SAH_AMX_TR181_XPON

if PACKAGE_tr181-xpon

menu "Select tr181-xpon build options"
    depends on PACKAGE_tr181-xpon

config SAH_AMX_TR181_XPON
    bool "Build a TR-181 XPON manager"
    default y

config SAH_AMX_TR181_XPON_ORDER
    int "TR-181 XPON manager start up order"
    default 30

config SAH_AMX_TR181_XPON_MAX_ONUS
    int "Maximum number of ONUs"
    default 1

config SAH_AMX_TR181_XPON_DISABLE_SUPPORT_FOR_PM_OBJECTS
    bool "Remove support for performance monitoring (PM) objects"
    default n
	help
	  Say Y if tr181-xpon should not support querying the parameters of the PM objects. The XPON DM always shows the PM objects, independent of the value of this option. Set to Y if your config uses a PON vendor module which does not support the PM objects to avoid error or warning messages when PM objects are queried for such a PON vendor module. Then the parameters of the PM objects stay 0.

config SAH_AMX_TR181_XPON_USE_NETDEV_COUNTERS
    bool "Get counters from netdev"
    default n
	help
	  If not enabled the vendor module is responsible for displaying the network statistics in the tr181-xpon datamodel

config SAH_AMX_TR181_XPON_RUN_AS_USER
    string "User will be used for the tr181-xpon plugin"
    default "tr181_app"

config SAH_AMX_TR181_XPON_RUN_AS_GROUP
    string "Group will be used for the tr181-xpon plugin"
    default "tr181_app"

endmenu

endif
```

## net_hl_services/plugins/tr181-captiveportal/Config.in
```kconfig
config PACKAGE_tr181-captiveportal
    tristate
    select SAH_AMX_TR181_CAPTIVEPORTAL

if PACKAGE_tr181-captiveportal

menu "Select tr181-captiveportal build options"
    depends on PACKAGE_tr181-captiveportal

config SAH_AMX_TR181_CAPTIVEPORTAL
    bool "Build the AMX Captive Portal plugin"
    default y

config SAH_AMX_TR181_CAPTIVEPORTAL_EXAMPLE
    bool "Install the example captive portal page"
    default y

config SAH_AMX_TR181_CAPTIVEPORTAL_START_ORDER
    int "Init start up order for the the AMX Captive Portal plugin"
    default 90

config SAH_AMX_TR181_CAPTIVEPORTAL_STOP_ORDER
    int "Init stop order for the AMX Captive Portal plugin"
    default 90

config SAH_AMX_TR181_CAPTIVEPORTAL_RUN_AS_USER
    string "User will be used for the tr181-captiveportal plugin"
    default "tr181_app"

config SAH_AMX_TR181_CAPTIVEPORTAL_RUN_AS_GROUP
    string "Group will be used for the tr181-captiveportal plugin"
    default "tr181_app"

endmenu

endif
```

## net_services/plugins/amx-processmonitor/Config.in
```kconfig
config PACKAGE_amx-processmonitor
    tristate
    select SAH_AMX_PROCESSMONITOR

if PACKAGE_amx-processmonitor

menu "Select amx-processmonitor build options"
    depends on PACKAGE_amx-processmonitor

config SAH_AMX_PROCESSMONITOR
    bool "Build processmonitor plugin"
    default y

config SAH_AMX_PROCESSMONITOR_RUN_AS_USER
    string "User will be used for the amx-processmonitor plugin"
    default "tr181_app"

config SAH_AMX_PROCESSMONITOR_RUN_AS_GROUP
    string "Group will be used for the amx-processmonitor plugin"
    default "tr181_app"

config SAH_AMX_PROCESSMONITOR_START_ORDER
    int "Start up order"
    default 99

config SAH_AMX_PROCESSMONITOR_STOP_ORDER
    int "Stop order"
    default 0

endmenu

endif
```

## net_services/plugins/multisettings/Config.in
```kconfig
config PACKAGE_multisettings
    tristate
    select SAH_AMX_MULTISETTINGS

if PACKAGE_multisettings

menu "Select multisettings build options"
    depends on PACKAGE_multisettings

config SAH_AMX_MULTISETTINGS
    bool "Build a tr181 compatible multisettings plugin"
    default y

config SAH_AMX_MULTISETTINGS_ORDER
    int "Start up order for the tr181 multisettings plugin"
    default 19

config SAH_AMX_MULTISETTINGS_RUN_AS_USER
    string "User will be used for the multisettings plugin"
    default "tr181_app"

config SAH_AMX_MULTISETTINGS_RUN_AS_GROUP
    string "Group will be used for the multisettings plugin"
    default "tr181_app"

endmenu

endif
```

## net_services/plugins/time-manager/Config.in
```kconfig
config PACKAGE_time-manager
    tristate
    select SAH_AMX_TR181_TIME

if PACKAGE_time-manager

menu "Select time-manager build options"
    depends on PACKAGE_time-manager

config SAH_AMX_TR181_TIME
    bool "Build a tr181 compatible time plugin"
    default y

config SAH_AMX_TR181_TIME_ORDER
    int "tr181 time plugin start up order"
    default 30

config SAH_AMX_TR181_TIME_RUN_AS_USER
    string "User will be used for the time-manager plugin"
    default "chrony"

config SAH_AMX_TR181_TIME_RUN_AS_GROUP
    string "Group will be used for the time-manager plugin"
    default "chrony"

endmenu

endif
```

## net_services/plugins/tr140-storageservice/Config.in
```kconfig
config PACKAGE_tr140-storageservice
    tristate
    select AMX_TR140_STORAGE_SERVICE

if PACKAGE_tr140-storageservice

menu "Select tr140-storageservice build options"
    depends on PACKAGE_tr140-storageservice

config AMX_TR140_STORAGE_SERVICE
    bool "Build a TR-140 compatible storage service manager"
    default y

config AMX_TR140_STORAGE_SERVICE_ORDER
    int "Start up order for the tr140-storageservice manager"
    default 70

config AMX_TR140_STORAGE_SERVICE_FOLDER_AUTO_ADD_USB_DEVICES_ROOT
    bool "Enable Folder auto add usb devices root"
    default n

config AMX_TR140_STORAGE_SERVICE_ENABLE_NTFS_3G
    bool "Enable ntfs-3g package. Only needed for kernel version <= 5.15 systems where native NTFS3 (CONFIG_NTFS3_FS) is not supported."
    default n

config AMX_TR140_STORAGE_SERVICE_RUN_AS_USER
    string "User will be used for the tr140-storageservice plugin"
    default "tr181_app"

config AMX_TR140_STORAGE_SERVICE_RUN_AS_GROUP
    string "Group will be used for the tr140-storageservice plugin"
    default "tr181_app"

endmenu

endif
```

## net_services/plugins/tr181-bulkdata/Config.in
```kconfig
config PACKAGE_tr181-bulkdata
    tristate
    select SAH_AMX_TR181_BULKDATA

if PACKAGE_tr181-bulkdata

menu "Select tr181-bulkdata build options"
    depends on PACKAGE_tr181-bulkdata

config SAH_AMX_TR181_BULKDATA
    bool "Build the TR-181 compatible bulkdata plugin"
    default y

config SAH_AMX_TR181_BULKDATA_START_ORDER
    int "TR-181 BulkData plugin start up order"
    default 90

config SAH_AMX_TR181_BULKDATA_STOP_ORDER
    int "TR-181 BulkData plugin shut down order"
    default 88

config SAH_AMX_TR181_BULKDATA_RUN_AS_USER
    string "User will be used for the tr181-bulkdata plugin"
    default "tr181_app"

config SAH_AMX_TR181_BULKDATA_RUN_AS_GROUP
    string "Group will be used for the tr181-bulkdata plugin"
    default "tr181_app"

endmenu

endif
```

## net_services/plugins/tr181-device/Config.in
```kconfig
config PACKAGE_tr181-device
    tristate
    select SAH_AMX_TR181_DEVICE

if PACKAGE_tr181-device

menu "Select tr181-device build options"
    depends on PACKAGE_tr181-device

config SAH_AMX_TR181_DEVICE
    bool "Build a tr181 compatible device plugin"
    default y

config SAH_AMX_TR181_DEVICE_ORDER
    int "Start up order for the tr181 device plugin"
    default 41

config SAH_AMX_TR181_DEVICE_RUN_AS_USER
    string "User will be used for the tr181-device plugin"
    default "tr181_app"

config SAH_AMX_TR181_DEVICE_RUN_AS_GROUP
    string "Group will be used for the tr181-device plugin"
    default "tr181_app"

endmenu

endif
```

## net_services/plugins/tr181-dynamicdns/Config.in
```kconfig
config PACKAGE_tr181-dynamicdns
    tristate
    select SAH_DYNAMIC_DNS

if PACKAGE_tr181-dynamicdns

menu "Select tr181-dynamicdns build options"
    depends on PACKAGE_tr181-dynamicdns

config SAH_DYNAMIC_DNS
    bool "Build the TR-181 Device.DynamicDNS"
    default y

config SAH_DYNAMIC_DNS_START_ORDER
    int "Init start up order for the the TR-181 Device.DynamicDNS plugin"
    default 25

config SAH_DYNAMIC_DNS_STOP_ORDER
    int "Init stop order for the the TR-181 Device.DynamicDNS plugin"
    default 10

config SAH_DYNAMIC_DNS_RUN_AS_USER
    string "User will be used for the tr181-dynamicdns plugin"
    default "tr181_app"

config SAH_DYNAMIC_DNS_RUN_AS_GROUP
    string "Group will be used for the tr181-dynamicdns plugin"
    default "tr181_app"

endmenu

endif
```

## net_services/plugins/tr181-homeplug/Config.in
```kconfig
config PACKAGE_tr181-homeplug
    tristate
    select SAH_AMX_TR181_HOMEPLUG

if PACKAGE_tr181-homeplug

menu "Select tr181-homeplug build options"
    depends on PACKAGE_tr181-homeplug

config SAH_AMX_TR181_HOMEPLUG
    bool "Build a tr181 compatible homeplug plugin"
    default y

config SAH_AMX_TR181_HOMEPLUG_START_ORDER
    int "Start up order for the tr181 homeplug plugin"
    default 31

config SAH_AMX_TR181_HOMEPLUG_STOP_ORDER
    int "Shutdown order for the tr181 homeplug plugin"
    default 69

config SAH_AMX_TR181_HOMEPLUG_RUN_AS_USER
    string "User will be used for the tr181-homeplug plugin"
    default "tr181_app"

config SAH_AMX_TR181_HOMEPLUG_RUN_AS_GROUP
    string "Group will be used for the tr181-homeplug plugin"
    default "tr181_app"

endmenu

endif
```

## net_services/plugins/tr181-httpaccess/Config.in
```kconfig
config PACKAGE_tr181-httpaccess
    tristate
    select SAH_AMX_TR181_HTTPACCESS

if PACKAGE_tr181-httpaccess

menu "Select tr181-httpaccess build options"
    depends on PACKAGE_tr181-httpaccess

config SAH_AMX_TR181_HTTPACCESS
    bool "Build HTTPAccess data model plug-in"
    default y

config SAH_AMX_TR181_HTTPACCESS_ORDER
    int "TR-181 HTTPAccess plugin start order"
    default 49

config SAH_AMX_TR181_HTTPACCESS_RUN_AS_USER
    string "User will be used for the tr181-httpaccess plugin"
    default "tr181_app"

config SAH_AMX_TR181_HTTPACCESS_RUN_AS_GROUP
    string "Group will be used for the tr181-httpaccess plugin"
    default "tr181_app"

config SAH_AMX_TR181_HTTPACCESS_FIREWALL
    bool "Configure Firewall"
    default y

endmenu

endif
```

## net_services/plugins/tr181-ipdiagnostics/Config.in
```kconfig
config PACKAGE_tr181-ipdiagnostics
    tristate
    select SAH_IP_DIAGNOSTICS

if PACKAGE_tr181-ipdiagnostics

menu "Select tr181-ipdiagnostics build options"
    depends on PACKAGE_tr181-ipdiagnostics

config SAH_IP_DIAGNOSTICS
    bool "Build the TR-181 IP.Diagnostics"
    default y

config PRPL_IP_DIAGNOSTIC_UPLOAD_DOWNLOAD
    bool "Build the TR-181 Device.IP.Diagnostics.DownloadDiagnostics and Device.IP.Diagnostics.UploadDiagnostics"
    default y

config SAH_IP_DIAGNOSTICS_START_ORDER
    int "Init start up order for the TR-181 IP.Diagnostics Plugin"
    default 25

config SAH_IP_DIAGNOSTICS_STOP_ORDER
    int "Init stop order for the TR-181 IP.Diagnostics Plugin"
    default 10

config SAH_IP_DIAGNOSTICS_RUN_AS_USER
    string "User will be used for the tr181-ipdiagnostics plugin"
    default "tr181_app"

config SAH_IP_DIAGNOSTICS_RUN_AS_GROUP
    string "Group will be used for the tr181-ipdiagnostics plugin"
    default "tr181_app"

endmenu

endif
```

## net_services/plugins/tr181-mqtt/Config.in
```kconfig
config PACKAGE_tr181-mqtt
    tristate
    select SAH_AMX_TR181_MQTT

if PACKAGE_tr181-mqtt

menu "Select tr181-mqtt build options"
    depends on PACKAGE_tr181-mqtt

config SAH_AMX_TR181_MQTT
    bool "TR-181 compatible MQTT client"
    default y

config SAH_AMX_TR181_MQTT_ORDER
    int "TR-181 MQTT client plugin start up order"
    default 49

config SAH_AMX_TR181_MQTT_RUN_AS_USER
    string "User will be used for the TR-181 MQTT plugin"
    default "tr181_app"

config SAH_AMX_TR181_MQTT_RUN_AS_GROUP
    string "Group will be used for the TR-181 MQTT plugin"
    default "tr181_app"

endmenu

endif
```
