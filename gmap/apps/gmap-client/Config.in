## net_services/plugins/tr181-periodicfileupload/Config.in
```kconfig
config PACKAGE_tr181-periodicfileupload
    tristate
    select SAH_AMX_TR181_PERIODICFILEUPLOAD

if PACKAGE_tr181-periodicfileupload

menu "Select tr181-periodicfileupload build options"
    depends on PACKAGE_tr181-periodicfileupload

config SAH_AMX_TR181_PERIODICFILEUPLOAD
    bool "Build a tr181 compatible periodic uploaded file manager"
    default y

config SAH_AMX_TR181_PERIODICFILEUPLOAD_ORDER
    int "Start up order for the tr181 uploaded file manager"
    default 99

config SAH_AMX_TR181_PERIODICFILEUPLOAD_RUN_AS_USER
    string "User will be used for the tr181-periodicfileupload plugin"
    default "tr181_app"

config SAH_AMX_TR181_PERIODICFILEUPLOAD_RUN_AS_GROUP
    string "Group will be used for the tr181-periodicfileupload plugin"
    default "tr181_app"

endmenu

endif
```

## net_services/plugins/tr181-syslog/Config.in
```kconfig
config PACKAGE_tr181-syslog
    tristate
    select SAH_AMX_TR181_SYSLOG

if PACKAGE_tr181-syslog

menu "Select tr181-syslog build options"
    depends on PACKAGE_tr181-syslog

config SAH_AMX_TR181_SYSLOG
    bool "TR-181 compatible syslog"
    default y

config SAH_AMX_TR181_SYSLOG_START_ORDER
    int "Init start up order for the TR-181 compatible syslog"
    default 12

config SAH_AMX_TR181_SYSLOG_STOP_ORDER
    int "Init stop order for the TR-181 compatible syslog"
    default 88

config SAH_AMX_TR181_SYSLOG_RUN_AS_USER
    string "User will be used for the TR-181 compatible syslog process"
    default "tr181_app"

config SAH_AMX_TR181_SYSLOG_RUN_AS_GROUP
    string "Group will be used for the TR-181 compatible syslog process"
    default "syslog"

endmenu

endif
```

## netmodel/plugins/netmodel/Config.in
```kconfig
config PACKAGE_netmodel
    tristate
    select SAH_AMX_NETMODEL

if PACKAGE_netmodel

menu "Select netmodel build options"
    depends on PACKAGE_netmodel

config SAH_AMX_NETMODEL
    bool "Build the Network Model plugin"
    default y

config SAH_AMX_NETMODEL_START_ORDER
    int "Network Model plugin startup order"
    default 20

config SAH_AMX_NETMODEL_STOP_ORDER
    int "Network Model plugin shutdown order"
    default 80

config SAH_AMX_NETMODEL_RUN_AS_USER
    string "User will be used for the NETMODEL plugin"
    default "tr181_app"

config SAH_AMX_NETMODEL_RUN_AS_GROUP
    string "Group will be used for the NETMODEL plugin"
    default "tr181_app"

config SAH_AMX_NETMODEL_DIRECT_SOCKET
    bool "Enable the usage of direct socket communication via PCB"
    default n

endmenu

endif
```

## qos_firewall/plugins/tr181-conntrack-query/Config.in
```kconfig
config PACKAGE_tr181-conntrack-query
    tristate
    select SAH_AMX_TR181_CONNTRACK_QUERY

if PACKAGE_tr181-conntrack-query

menu "Select tr181-conntrack-query build options"
    depends on PACKAGE_tr181-conntrack-query

config SAH_AMX_TR181_CONNTRACK_QUERY
    bool "Build a tr181-conntrack-query plugin"
    default y

config SAH_AMX_TR181_CONNTRACK_QUERY_ORDER
    int "Start up order for the tr181-conntrack-query plugin"
    default 25

config SAH_AMX_TR181_CONNTRACK_QUERY_RUN_AS_USER
    string "User will be used for the tr181-conntrack-query plugin"
    default "tr181_app"

config SAH_AMX_TR181_CONNTRACK_QUERY_RUN_AS_GROUP
    string "Group will be used for the tr181-conntrack-query plugin"
    default "tr181_app"

endmenu

endif
```

## qos_firewall/plugins/tr181-qos/Config.in
```kconfig
config PACKAGE_tr181-qos
    tristate
    select SAH_AMX_TR181_QOS

if PACKAGE_tr181-qos

menu "Select tr181-qos build options"
    depends on PACKAGE_tr181-qos

config SAH_AMX_TR181_QOS
    bool "Build A TR-181 Compatible QOS manager"
    default y

config SAH_AMX_TR181_QOS_ORDER
    int "TR-181 QoS plugin start order"
    default 49

config SAH_AMX_TR181_QOS_DEVICE_BASED_CLASSIFICATION
    bool "Enable device based classification"
    default y

config SAH_AMX_TR181_QOS_RUN_AS_USER
    string "User will be used for the tr181-qos plugin"
    default "tr181_app"

config SAH_AMX_TR181_QOS_RUN_AS_GROUP
    string "Group will be used for the tr181-qos plugin"
    default "tr181_app"

endmenu

endif
```

## tr-069/plugins/tr069-manager/Config.in
```kconfig
config PACKAGE_tr069-manager
    tristate
    select SAH_AMX_TR069_MANAGER

if PACKAGE_tr069-manager

menu "Select tr069-manager build options"
    depends on PACKAGE_tr069-manager

config SAH_AMX_TR069_MANAGER
    bool "Build TR069 Manager"
    default y

config SAH_AMX_TR069_MANAGER_ORDER
    int "TR069 Manager start up order"
    default 97

config SAH_AMX_TR069_MANAGER_CERTIFICATE_NO_PEM
    bool "Allow not to use any certificate"
    default n

config SAH_AMX_TR069_MANAGER_USE_GSDM
    bool "Use get_supported() instead of describe() "
    default n

config SAH_AMX_TR069_MANAGER_RUN_AS_USER
    string "User will be used for the tr069-manager plugin"
    default "tr181_app"

config SAH_AMX_TR069_MANAGER_RUN_AS_GROUP
    string "Group will be used for the tr069-manager plugin"
    default "tr181_app"

endmenu

endif
```
