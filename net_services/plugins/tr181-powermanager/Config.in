## net_services/plugins/tr181-powermanager/Config.in
```kconfig
config PACKAGE_tr181-powermanager
    tristate
    select SAH_AMX_TR181_POWERMANAGER

if PACKAGE_tr181-powermanager

menu "Select tr181-powermanager build options"
    depends on PACKAGE_tr181-powermanager

config SAH_AMX_TR181_POWERMANAGER
    bool "Build a tr181 compatible For Deep Standby"
    default y

config SAH_AMX_TR181_POWERMANAGER_START_ORDER
    int "tr181 powermanager plugin start up order"
    default 81

config SAH_AMX_TR181_POWERMANAGER_STOP_ORDER
    int "tr181 powermanager plugin shutdown order"
    default 19

config SAH_AMX_TR181_POWERMANAGER_RUN_AS_USER
    string "User will be used for the TR-181 compatible powermanager process"
    default "tr181_app"

config SAH_AMX_TR181_POWERMANAGER_RUN_AS_GROUP
    string "Group will be used for the TR-181 compatible powermanager process"
    default "tr181_app"

endmenu

endif
```
