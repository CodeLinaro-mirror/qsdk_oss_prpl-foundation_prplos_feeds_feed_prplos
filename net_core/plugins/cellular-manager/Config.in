## net_core/plugins/cellular-manager/Config.in
```kconfig
config PACKAGE_cellular-manager
    tristate
    select SAH_AMX_TR181_CELLULAR

if PACKAGE_cellular-manager

menu "Select cellular-manager build options"
    depends on PACKAGE_cellular-manager

config SAH_AMX_TR181_CELLULAR
    bool "Build a tr181 compatible cellular plugin"
    default y

config SAH_AMX_TR181_CELLULAR_ORDER
    int "Start up order for the tr181 cellular plugin"
    default 97

config SAH_AMX_TR181_CELLULAR_RUN_AS_USER
    string "User will be used for the cellular-manager plugin"
    default "tr181_app"

config SAH_AMX_TR181_CELLULAR_RUN_AS_GROUP
    string "Group will be used for the cellular-manager plugin"
    default "tr181_app"

endmenu

endif
```

## net_core/plugins/tr181-barometer/Config.in
```kconfig
config PACKAGE_tr181-barometer
	tristate
	select AMX_TR181_BAROMETER

if PACKAGE_tr181-barometer

menu "Select tr181-barometer build options"
	depends on PACKAGE_tr181-barometer

config AMX_TR181_BAROMETER
	bool "Build a tr181 compatible barometer plugin"
	default y

config AMX_TR181_BAROMETER_ORDER
	int "tr181-barometer Plugin start up order"
	default 20 

config AMX_TR181_BAROMETER_RUN_AS_USER
	string "User will be used for the tr181-barometer plugin"
	default "tr181_app"

config AMX_TR181_BAROMETER_RUN_AS_GROUP
	string "Group will be used for the tr181-barometer plugin"
	default "tr181_app"

config AMX_TR181_BAROMETER_IIO_PATH
        string "path"
        default ""

config AMX_TR181_BAROMETER_VERTICAL_UNCERTAINTY
        string "Uncertainty"
        default ""

config AMX_TR181_BAROMETER_PRESSURE_ACCURACY_PA
        string "accuracy"
        default ""

endmenu

endif
```

## net_core/plugins/tr181-gps/Config.in
```kconfig
config PACKAGE_tr181-gps
	tristate
	select AMX_TR181_GPS

if PACKAGE_tr181-gps

menu "Select tr181-gps build options"
	depends on PACKAGE_tr181-gps

config AMX_TR181_GPS
	bool "Build a tr181 compatible gps plugin"
	default y

config AMX_TR181_GPS_ORDER
	int "tr181-gps Plugin start up order"
	default 52 

config AMX_TR181_GPS_RUN_AS_USER
	string "User will be used for the tr181-gps plugin"
	default "tr181_app"

config AMX_TR181_GPS_RUN_AS_GROUP
	string "Group will be used for the tr181-gps plugin"
	default "tr181_app"

config AMX_TR181_GPS_DEVICE
	string "The GPS UART device"
	default ""

config AMX_TR181_GPS_BAUDRATE
	string "The GPS UART device baud rate"
	default ""
endmenu

endif
```

## net_services/plugins/tr181-gre/Config.in
```kconfig
config PACKAGE_tr181-gre
    tristate
    select SAH_AMX_TR181_GRE

if PACKAGE_tr181-gre

menu "Select tr181-gre build options"
    depends on PACKAGE_tr181-gre

config SAH_AMX_TR181_GRE
    bool "Build a tr181 compatible gre tunnel manager"
    default y

config SAH_AMX_TR181_GRE_START_ORDER
    int "tr181 gre plugin start up order"
    default 81

config SAH_AMX_TR181_GRE_STOP_ORDER
    int "tr181 gre plugin shutdown order"
    default 19

config SAH_AMX_TR181_GRE_RUN_AS_USER
    string "User to be used for the tr181 GRE plugin"
    default "tr181_app"

config SAH_AMX_TR181_GRE_RUN_AS_GROUP
    string "Group to be used for the tr181 GRE plugin"
    default "tr181_app"

endmenu

endif
```

## net_services/plugins/tr181-ipsec/Config.in
```kconfig
config PACKAGE_tr181-ipsec
    tristate
    select SAH_AMX_TR181_IPSEC

if PACKAGE_tr181-ipsec

menu "Select tr181-ipsec build options"
    depends on PACKAGE_tr181-ipsec

config SAH_AMX_TR181_IPSEC
    bool "Build tr181-ipsec plugin"
    default y

config SAH_AMX_TR181_IPSEC_START_ORDER
    int "start up order of tr181-ipsec plugin"
    default 84

config SAH_AMX_TR181_IPSEC_STOP_ORDER
    int "shutdown order of tr181-ipsec plugin"
    default 16

config SAH_AMX_TR181_IPSEC_RUN_AS_USER
    string "User to be used for the tr181 IPsec plugin"
    default "tr181_app"

config SAH_AMX_TR181_IPSEC_RUN_AS_GROUP
    string "Group to be used for the tr181 IPsec plugin"
    default "tr181_app"

endmenu

endif
```

## net_services/plugins/tr181-tuntap/Config.in
```kconfig
config PACKAGE_tr181-tuntap
    tristate
    select SAH_AMX_TR181_TUNTAP

if PACKAGE_tr181-tuntap

menu "Select tr181-tuntap build options"
    depends on PACKAGE_tr181-tuntap

config SAH_AMX_TR181_TUNTAP
    bool "Build a tr181 compatible tuntap manager"
    default y

config SAH_AMX_TR181_TUNTAP_START_ORDER
    int "tr181 tuntap plugin start up order"
    default 82

config SAH_AMX_TR181_TUNTAP_STOP_ORDER
    int "tr181 tuntap plugin shutdown order"
    default 18

config SAH_AMX_TR181_TUNTAP_RUN_AS_USER
    string "User to be used for the tr181 tuntap plugin"
    default "tr181_app"

config SAH_AMX_TR181_TUNTAP_RUN_AS_GROUP
    string "Group to be used for the tr181 tuntap plugin"
    default "tr181_app"

endmenu

endif
```

## net_services/plugins/tr181-wireguard/Config.in
```kconfig
config PACKAGE_tr181-wireguard
    tristate
    select SAH_AMX_TR181_WIREGUARD

if PACKAGE_tr181-wireguard

menu "Select tr181-wireguard build options"
    depends on PACKAGE_tr181-wireguard

config SAH_AMX_TR181_WIREGUARD
    bool "Build a tr181 compatible WireGuard plugin"
    default y

config SAH_AMX_TR181_WIREGUARD_START_ORDER
    int "Start up order for the tr181 WireGuard plugin"
    default 25

config SAH_AMX_TR181_WIREGUARD_STOP_ORDER
    int "Shutdown order for the tr181 WireGuard plugin"
    default 75

config SAH_AMX_TR181_WIREGUARD_RUN_AS_USER
    string "User to be used for the tr181 Wireguard plugin"
    default "tr181_app"

config SAH_AMX_TR181_WIREGUARD_RUN_AS_GROUP
    string "Group to be used for the tr181 Wireguard plugin"
    default "tr181_app"

endmenu

endif
```

## net_services/plugins/tr181-zram/Config.in
```kconfig
config PACKAGE_tr181-zram
    tristate
    select SAH_AMX_TR181_ZRAM

if PACKAGE_tr181-zram

menu "Select tr181-zram build options"
    depends on PACKAGE_tr181-zram

config SAH_AMX_TR181_ZRAM
    bool "Build the tr181 swap and ZRAM plugin"
    default y
    select BUSYBOX_CONFIG_MKSWAP

config SAH_AMX_TR181_ZRAM_ORDER
    int "Start up order for the tr181 ZRAM plugin"
    default 13
	help
	  Must be after sysctl (11), whose vm.swappiness the plugin overrides,
	  and is after tr181-syslog (12). The init script waits for syslog-ng
	  (syslog-ng-ctl, at most 60 s) before it starts the plugin.

endmenu

endif
```

## qos_firewall/plugins/packet-interception/Config.in
```kconfig
config PACKAGE_packet-interception
    tristate
    select SAH_AMX_PACKET_INTERCEPTION

if PACKAGE_packet-interception

menu "Select packet-interception build options"
    depends on PACKAGE_packet-interception

config SAH_AMX_PACKET_INTERCEPTION
    bool "Build a packet interception component"
    default y

config SAH_AMX_PACKET_INTERCEPTION_ORDER
    int "Start up order"
    default 50

config SAH_AMX_PACKET_INTERCEPTION_TR181_FIREWALL_RULEPATH
    string "Firewall iptables rules folder location"
    default "/etc/amx/tr181-firewall"

config SAH_AMX_PACKET_INTERCEPTION_SUPPORT_SKIPLOG
    bool "Support skiplog"
    default n

config SAH_AMX_PACKET_INTERCEPTION_RUN_AS_USER
    string "User will be used for the packet-interception plugin"
    default "tr181_app"

config SAH_AMX_PACKET_INTERCEPTION_RUN_AS_GROUP
    string "Group will be used for the packet-interception plugin"
    default "tr181_app"

config SAH_AMX_PACKET_INTERCEPTION_NOT_OFFLOAD_MARK
    int "SKB mark set to not offload packets to hardware accelerator"
    default 32

config SAH_AMX_PACKET_INTERCEPTION_TCPRESET_MARK
    int "Connmark set to apply a TCP RST to the connection"
    default 1

endmenu

endif
```
